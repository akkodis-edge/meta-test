## conf/layer.conf
```bitbake
# We have a conf and classes directory, add to BBPATH
BBPATH .= ":${LAYERDIR}"

# We have recipes-* directories, add to BBFILES
BBFILES += "${LAYERDIR}/recipes-*/*/*.bb \
            ${LAYERDIR}/recipes-*/*/*.bbappend"

BBFILE_COLLECTIONS += "test-layer"
BBFILE_PATTERN_test-layer = "^${LAYERDIR}/"
BBFILE_PRIORITY_test-layer = "6"

LAYERDEPENDS_test-layer = "core meta-python"
LAYERSERIES_COMPAT_test-layer = "kirkstone"
```
